## components/dashboard/Kconfig
```kconfig
menu "Dashboard"

config DASHBOARD_ENABLE
    bool "Enable Debugging Dashboard"
    default y
    help
        Start HTTP server on port 80 to serve the debugging dashboard webpage.

config DASHBOARD_PORT
    int "Dashboard server port"
    default 80
    range 1 65535
    help
        Port to run the HTTP server on.

endmenu
```

## components/logger/Kconfig
```kconfig
menu "Logger"

config LOGGER_SERIAL_OUTPUT
    bool "Enable serial output"
    default n
    help
        Log received parameters and failure events using ESP_LOG (UART output).

config LOGGER_WIFI_PERIOD_HOURS
    int "WiFi/MQTT publish period (hours)"
    default 6
    range 1 168
    help
        Period between MQTT uploads of parameter batches.

config LOGGER_WIFI_SSID
    string "WiFi SSID"
    default ""

config LOGGER_WIFI_PASSWORD
    string "WiFi password"
    default ""

config LOGGER_WIFI_ENT_ENABLE
    bool "Enable WPA2-Enterprise (PEAP)"
    default n
    help
        Use WPA2-Enterprise PEAP authentication instead of WPA2-Personal (PSK).

config LOGGER_WIFI_ENT_IDENTITY
    string "WPA2-Enterprise Identity"
    default ""
    depends on LOGGER_WIFI_ENT_ENABLE

config LOGGER_WIFI_ENT_USERNAME
    string "WPA2-Enterprise Username"
    default ""
    depends on LOGGER_WIFI_ENT_ENABLE

config LOGGER_WIFI_ENT_PASSWORD
    string "WPA2-Enterprise Password"
    default ""
    depends on LOGGER_WIFI_ENT_ENABLE


config LOGGER_NTP_SERVER
    string "NTP server"
    default "pool.ntp.org"

config LOGGER_NODE_ID
    string "Node ID"
    default ""
    help
        Unique node identifier used as MQTT topic prefix (e.g., ranting/{node_id}/parameters).
        Leave empty to auto-generate a random adjective-noun ID at first boot (persisted in NVS).
        Set a non-empty value to override with a known provisioning ID (NVS is skipped).

config LOGGER_MQTT_URI
    string "MQTT broker URI"
    default "mqtt://broker.hivemq.com"

config LOGGER_MQTT_USERNAME
    string "MQTT username"
    default ""

config LOGGER_MQTT_PASSWORD
    string "MQTT password"
    default ""

config LOGGER_MQTT_CLIENT_ID
    string "MQTT client ID"
    default "ranting-logger"

config LOGGER_MQTT_TOPIC_PARAMETERS
    string "MQTT parameters topic suffix"
    default "parameters"
    help
        MQTT topic suffix for parameter data. The full topic is constructed
        at runtime as ranting/{node_id}/{suffix} where {node_id} is resolved
        from CONFIG_LOGGER_NODE_ID, NVS, or auto-generated.

config LOGGER_MQTT_TOPIC_FAILURES
    string "MQTT failure topic suffix"
    default "failures"
    help
        MQTT topic suffix for failure events. The full topic is constructed
        at runtime as ranting/{node_id}/{suffix}.

config LOGGER_MQTT_QOS
    int "MQTT QoS"
    default 0
    range 0 2

endmenu
```

## components/monitor/Kconfig
```kconfig
menu "Monitor"

config MONITOR_STORAGE_MINUTES
    int "Tilt data storage minutes"
    default 5
    range 1 60
    help
        Number of minutes of tilt data stored for statistics and FFT.

config MONITOR_IMU_RATE_HZ
    int "IMU sampling rate (Hz)"
    default 52
    range 1 208
    help
        Target IMU sampling rate in Hz for monitor processing loop.

choice MONITOR_AE_MODE
    prompt "Acoustic emission mode"
    default MONITOR_AE_MODE_GPIO
    help
        Select acoustic emission failure detection mode.

config MONITOR_AE_MODE_GPIO
    bool "GPIO interrupt (digital)"

config MONITOR_AE_MODE_ADC
    bool "ADC threshold (analog)"

config MONITOR_AE_MODE_SPECTRAL_ADC
    bool "ADC spectral detector (analog)"

endchoice

config MONITOR_AE_ADC_THRESHOLD
    int "AE ADC threshold"
    default 3000
    range 0 4095
    help
        Raw ADC threshold for acoustic emission failure.

config MONITOR_AE_SPECTRAL_SAMPLE_RATE_HZ
    int "AE spectral ADC sample rate (Hz)"
    default 40000
    range 1000 80000
    help
        Continuous ADC sampling rate for spectral acoustic emission detection.

config MONITOR_AE_SPECTRAL_WINDOW_SIZE
    int "AE spectral FFT window samples"
    default 256
    range 64 1024
    help
        FFT window length. Must be a power of two.

config MONITOR_AE_SPECTRAL_BIN_START
    int "AE spectral first energy bin"
    default 64
    range 1 511
    help
        Inclusive positive-frequency FFT bin where high-frequency energy starts.

config MONITOR_AE_SPECTRAL_BIN_END
    int "AE spectral last energy bin"
    default 127
    range 1 511
    help
        Inclusive positive-frequency FFT bin where high-frequency energy ends.

config MONITOR_AE_SPECTRAL_LEAK_ALPHA_X100
    int "AE spectral leak alpha (x100)"
    default 95
    range 0 100
    help
        Leaking integrator alpha. Default 95 means 0.95.

config MONITOR_AE_SPECTRAL_EWMA_ALPHA_X100
    int "AE spectral EWMA alpha (x100)"
    default 5
    range 1 100
    help
        EWMA baseline alpha. Default 5 means 0.05.

config MONITOR_AE_SPECTRAL_DANGER_MULTIPLIER_X10
    int "AE spectral danger multiplier (x10)"
    default 60
    range 1 1000
    help
        Dynamic danger threshold multiplier. Default 60 means 6.0.

config MONITOR_AE_SPECTRAL_GRADIENT_WINDOW
    int "AE spectral gradient window"
    default 20
    range 2 256
    help
        Number of integrator samples used for gradient comparison.

config MONITOR_AE_SPECTRAL_JUMP_THRESHOLD_X10
    int "AE spectral jump threshold (x10)"
    default 64
    range 0 100000
    help
        Energy jump latch threshold. Default 64 means 6.4.

config MONITOR_AE_SPECTRAL_LATCH_DURATION_MS
    int "AE spectral latch duration (ms)"
    default 2000
    range 1 60000
    help
        Duration to hold energy-jump latch active after sudden high-frequency energy increase.

config MONITOR_AE_SPECTRAL_MIN_PUBLISH_INTERVAL_MS
    int "AE spectral minimum publish interval (ms)"
    default 2000
    range 0 60000
    help
        Minimum interval for repeated acoustic emission publishes while spectral conditions stay active.

config MONITOR_PEAK_MIN_AMPLITUDE_X10
    int "Peak detection min amplitude (deg x10)"
    default 5
    range 1 900
    help
        Minimum peak amplitude in degrees (scaled by 10) for sway and damping detection.

config MONITOR_PEAK_MIN_SPACING_SAMPLES
    int "Peak detection min spacing (samples)"
    default 2
    range 1 500
    help
        Minimum sample spacing between peaks for sway and damping detection.

config MONITOR_MODAL_FREQ_MIN_HZ_X10
    int "Modal FFT minimum frequency (Hz x10)"
    default 5
    range 0 1000
    help
        Minimum non-DC FFT frequency in Hz (scaled by 10) eligible for modal
        natural-frequency selection.

config MONITOR_MODAL_FREQ_MAX_HZ_X10
    int "Modal FFT maximum frequency (Hz x10)"
    default 120
    range 1 2000
    help
        Maximum FFT frequency in Hz (scaled by 10) eligible for modal
        natural-frequency selection.

config MONITOR_DSP_TKEO_HIGH_X10
    int "DSP TKEO high threshold (x10)"
    default 400
    range 1 100000
    help
        Streaming gyro-magnitude TKEO threshold for entering DISTURBED.
        Default 400 means 40.0.

config MONITOR_DSP_TKEO_LOW_X10
    int "DSP TKEO low threshold (x10)"
    default 50
    range 0 100000
    help
        Streaming gyro-magnitude TKEO quiet threshold for DISTURBED exit.
        Default 50 means 5.0.

config MONITOR_DSP_GMAG_ONSET_X100
    int "DSP gyro magnitude onset threshold (dps x100)"
    default 200
    range 0 100000
    help
        Calibrated gyro magnitude threshold for entering DISTURBED.
        Default 200 means 2.0 dps.

config MONITOR_DSP_GMAG_QUIET_X100
    int "DSP gyro magnitude quiet threshold (dps x100)"
    default 150
    range 0 100000
    help
        Calibrated gyro magnitude threshold for quiet debounce.
        Default 150 means 1.5 dps.

config MONITOR_FREEFALL_THS
    int "Free-fall threshold (raw)"
    default 3
    range 1 7
    help
        LSM6DS3 free-fall threshold (register value).

config MONITOR_FF_DUR
    int "Free-fall duration (FF_DUR)"
    default 5
    range 0 31
    help
        Free-fall duration event. Duration = FF_DUR + 1 in ODR cycles.
        Each LSB extends duration by 1 ODR.

config MONITOR_FFT_DE_MEAN_ENABLE
    bool "Enable de-meaning/zero-centering of FFT input"
    default y
    help
        Removes the mean (DC component) from input tilt vector before performing FFT to avoid a 0Hz peak.

config MONITOR_SHORT_BUFFER_SIZE
    int "Short buffer size for pre-disturbance history"
    default 256
    range 10 1024
    help
        Size of the short buffer for pre-disturbance history backfill on IDLE→DISTURBED transitions.

config MONITOR_N_DPAD
    int "DISTURBED buffer refresh margin (samples)"
    default 100
    range 10 1000
    help
        Number of samples before the 5-min buffer is full at which the buffer will be refreshed during a prolonged DISTURBED state.

config MONITOR_IMU_CALIBRATION
    bool "Enable IMU bias calibration"
    default y
    help
        When enabled, static accel/gyro biases are read from NVS and subtracted
        from raw IMU values before filter processing. Biases default to zero if
        NVS key missing.

config MONITOR_DISTURBED_EXIT_DEBOUNCE
    int "DISTURBED to IDLE exit debounce count (samples)"
    default 64
    range 1 1000
    help
        Number of consecutive samples below the low threshold to transition to IDLE.

config MONITOR_NOISE_GATE_GMAG_X10
    int "Noise gate minimum peak gyro magnitude (dps x10)"
    default 80
    range 0 100000
    help
        Minimum peak gyro magnitude for damping computation.
        Default 80 means 8.0 dps. Events with peak gyro magnitude
        below this threshold skip damping ratio computation.

endmenu
```

## main/Kconfig
```kconfig
config APP_BUILD_RAW_LOGGER
    bool "Build raw IMU logger binary instead of monitoring app"
    default n
    help
        When enabled, compiles a standalone raw IMU data logger (raw_logger_main.cpp)
        instead of the main monitoring application. The logger writes raw accelerometer,
        gyroscope, and temperature samples to SD card in CSV format with no processing.

        Disable this to build the normal monitoring application.

menu "Application Storage"

choice APP_SD_INTERFACE
    prompt "SD card interface"
    default APP_SD_INTERFACE_SDMMC

config APP_SD_INTERFACE_SDMMC
    bool "SDMMC 1-bit"

config APP_SD_INTERFACE_SPI
    bool "SPI (SDSPI)"

endchoice

config APP_SD_MOUNT_POINT
    string "SD card mount point"
    default "/sdcard"

endmenu

menu "Application Verification"

config APP_VERIFY_ENABLE
    bool "Enable startup verification"
    default y

config APP_VERIFY_MQTT_TOPIC
    string "MQTT verify topic"
    default "ranting/verify"
    help
        DEPRECATED: This option is no longer used. The verify utility now
        uses the runtime node ID-prefixed topic from logger::mqtt::GetTopic().
        The topic will be "ranting/{node_id}/verify" where node_id is
        resolved from Kconfig, NVS, or auto-generation.

    config APP_VERIFY_MONITOR_TIMEOUT_MS
    int "Monitor verify timeout (ms)"
    default 5000
    range 100 600000

endmenu

menu "Raw IMU Logger"
    depends on APP_BUILD_RAW_LOGGER

    config RAW_LOGGER_IMU_RATE_HZ
        int "IMU sampling rate (Hz)"
        default 26
        range 26 208
        help
            LSM6DS3 output data rate for raw logging. Valid values: 26, 52, 104, 208 Hz.
            Higher rates produce larger CSV files (~90 bytes/row).

    config RAW_LOGGER_DURATION_S
        int "Recording duration (seconds, 0 = indefinite)"
        default 0
        range 0 86400
        help
            Number of seconds to record before stopping. Set to 0 for indefinite recording
            until power is removed. Duration is approximate based on sample count
            (duration_s * rate_hz samples).

endmenu
```
