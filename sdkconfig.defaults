## sdkconfig.defaults
```kconfig
CONFIG_MQTT_PROTOCOL_5=y
CONFIG_LOG_VERSION_2=y
CONFIG_ESP_IPC_TASK_STACK_SIZE=3072
CONFIG_IPC_TASK_STACK_SIZE=3072
CONFIG_ESP_WIFI_STATIC_RX_BUFFER_NUM=6
CONFIG_ESP_WIFI_DYNAMIC_RX_BUFFER_NUM=32
CONFIG_ESP_WIFI_DYNAMIC_TX_BUFFER_NUM=32
CONFIG_LWIP_TCPIP_RECVMBOX_SIZE=16
CONFIG_MONITOR_AE_MODE_SPECTRAL_ADC=y
CONFIG_MONITOR_AE_SPECTRAL_DANGER_MULTIPLIER_X10=150
CONFIG_MONITOR_AE_SPECTRAL_JUMP_THRESHOLD_X10=200
```
